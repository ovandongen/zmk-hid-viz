## Kconfig
```kconfig
menu "HID Viz"

config HID_VIZ
    bool "Enable HID Viz keyboard visualization module"
    depends on RAW_HID
    help
      Enables the HID Viz module which provides layer-state
      notifications, key-event notifications, and a command handler
      for host-initiated actions, layered on top of the zmk-raw-hid
      transport module. Requires CONFIG_RAW_HID=y to be set
      explicitly alongside this option.
      On split keyboards RAW_HID itself is enabled only on the
      central half, which transitively gates this module.

config HID_VIZ_LAYER_EVENTS
    bool "Send layer state change events"
    default y
    depends on HID_VIZ
    help
      Send a notification to the host whenever the active layer changes.

config HID_VIZ_KEY_EVENTS
    bool "Send key press/release events"
    default y
    depends on HID_VIZ
    help
      Send a notification to the host for every physical key press and release.

config HID_VIZ_COMMANDS
    bool "Accept commands from host"
    default y
    depends on HID_VIZ
    help
      Handle inbound commands from the host app, such as device info
      queries and layer switching. Also enables the layer action
      commands setBase (0xF4), activate (0xF3), and deactivate (0xF2).

config HID_VIZ_MANIFEST
    bool "Respond to manifest queries (0xF9)"
    default y
    depends on HID_VIZ
    help
      Handle CMD_GET_MANIFEST (0xF9) commands, emitting one
      RSP_MANIFEST_ENTRY (0xF8) report per capability. Lets the host
      auto-discover the device's identity and full capability surface
      (what it notifies / handles / triggers) in a single query.

config HID_VIZ_EMIT
    bool "Emit behavior (originator / triggers)"
    default n
    depends on HID_VIZ
    help
      Build the &hid_viz_emit keymap behavior, which emits a capability
      action onto the raw HID bus on key press, fire-and-forget. Bind it
      in your keymap, e.g. `&hid_viz_emit POINTING_DPI_SET 800`. Requires
      a device node in your keymap (see README). Off by default; enable on
      keyboards that originate actions (e.g. pointing/RGB) for another
      device to fulfill.

config HID_VIZ_RGB
    bool "RGB profile (core.rgb.*)"
    default n
    depends on HID_VIZ
    depends on ZMK_RGB_UNDERGLOW
    help
      Handle core.rgb.set (0xD1) commands from the host — global on/off,
      hue/saturation/brightness, and effect index against the stock ZMK
      underglow API — and emit a core.rgb.changed (0xD0) receipt after
      applying. Global RGB only: per-key colour on ZMK is derived locally
      from layer state, so hosts change that picture via core.layer.*
      instead. Enable on boards with RGB underglow.

config HID_VIZ_CONFIG_ID
    string "Layout/config identifier"
    default ""
    depends on HID_VIZ_COMMANDS
    help
      An identifier string (e.g. a GUID or layout name) that the host
      app can query to automatically load the correct layout definition.
      Set this to the ID from your layout editor export, or leave empty
      for manual layout selection in the host app.

endmenu
```

## boards/shields/raw_hid_adapter/Kconfig.shield
```kconfig
config SHIELD_RAW_HID_ADAPTER
    def_bool $(shields_list_contains,raw_hid_adapter)
```

## dts/bindings/behaviors/zmk,behavior-hid-signal-fixed.yaml
```yaml
description: |
  HID Viz fixed (devicetree-configured) signal behavior. A zero-cell sibling of
  zmk,behavior-hid-signal: the id is set as a devicetree property on the node
  instead of as a keymap parameter, so the behavior can be placed and bound by
  label (e.g. &signal_7) without a constant on the key. This is the form usable
  from the MoErgo Glove80 Layout Editor's custom behaviors / custom devicetree
  facility.

    id = <7>;   // uint8, sent in byte[1]

  On press it fires the same wire message as the 1-cell form, and each node also
  self-registers an enumerated `signal.fire/<id>` capability in the manifest, so a
  host scan sees exactly which ids the board fires.

compatible: "zmk,behavior-hid-signal-fixed"

include: zero_param.yaml

properties:
  id:
    type: int
    required: true
    description: The opaque host-defined signal id (0-255), sent in byte[1].
```

## dts/bindings/behaviors/zmk,behavior-hid-signal.yaml
```yaml
description: |
  HID Viz signal behavior. On key press it fires a generic, host-defined trigger
  onto the raw HID bus, fire-and-forget (no ref, no reply). One parameter:
    param1 = id (uint8), sent in byte[1]

  The id is opaque on the wire — all meaning lives in the listening host's config
  (see docs/signal-capability-spec.md). Because the id is a keymap binding
  parameter it cannot be enumerated, so this form advertises the bare
  `signal.fire` capability. Use zmk,behavior-hid-signal-fixed when you want each
  id listed in the manifest.

compatible: "zmk,behavior-hid-signal"

include: one_param.yaml
```

## dts/bindings/behaviors/zmk,behavior-hid-viz-emit-fixed.yaml
```yaml
description: |
  HID Viz fixed (devicetree-configured) emit behavior. A zero-cell sibling of
  zmk,behavior-hid-viz-emit: the action and value are set as devicetree
  properties on the node instead of as keymap parameters, so the behavior can be
  placed and bound by label (e.g. &dpi_800) without a constant #include on the
  key. This is the form usable from the MoErgo Glove80 Layout Editor's custom
  behaviors / custom devicetree facility.

    action = "core.pointing.dpi.set";   // string enum -> wire byte at compile time
    value  = <800>;                       // uint32, sent little-endian

  On press it emits the same wire message as the 2-cell form, so the device also
  advertises the action as a `triggers` capability in its manifest.

compatible: "zmk,behavior-hid-viz-emit-fixed"

include: zero_param.yaml

properties:
  action:
    type: string
    required: true
    description: |
      Capability ID of the action to emit. The enum ORDER must stay in sync with
      the HID_VIZ_ACTION_* table in src/capabilities.h (the index maps to the
      wire byte and tier at compile time).
    enum:
      - "core.pointing.dpi.set"
      - "core.pointing.dpi.setIndex"
      - "core.pointing.dragScroll.set"
      - "core.pointing.snipe.set"
  value:
    type: int
    required: true
    description: The uint32 value to send little-endian in bytes[1..4].
```

## dts/bindings/behaviors/zmk,behavior-hid-viz-emit.yaml
```yaml
description: |
  HID Viz emit behavior. On key press it emits a capability action onto the
  raw HID bus, fire-and-forget (no ref, no reply). Two parameters:
    param1 = action wire byte (e.g. POINTING_DPI_SET from
             <dt-bindings/hid_viz/emit.h>)
    param2 = a uint32 value, sent little-endian in bytes[1..4]

compatible: "zmk,behavior-hid-viz-emit"

include: two_param.yaml
```
